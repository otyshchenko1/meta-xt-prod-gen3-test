## recipes-domx/meta-xt-prod-vgpu/conf/layer.conf
```bitbake
# We have a conf and classes directory, add to BBPATH
BBPATH =. "${LAYERDIR}:"

# We have recipes-* directories, add to BBFILES
BBFILES += "${LAYERDIR}/recipes-*/*/*.bb \
            ${LAYERDIR}/recipes-*/*/*.bbappend"

BBFILE_COLLECTIONS += "meta-xt-prod-vgpu"
BBFILE_PATTERN_meta-xt-prod-vgpu = "^${LAYERDIR}/"
BBFILE_PRIORITY_meta-xt-prod-vgpu = "6"
```
